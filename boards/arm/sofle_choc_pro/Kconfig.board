## boards/arm/sofle_choc_pro/Kconfig.board
```kconfig
# Copyright (c) 2020 The ZMK Contributors
# SPDX-License-Identifier: MIT

config BOARD_SOFLE_CHOC_PRO_LEFT
	bool "Sofle Choc Pro Left"
	depends on SOC_NRF52840_QIAA
	imply RETAINED_MEM
	imply RETENTION
	imply RETENTION_BOOT_MODE

config BOARD_SOFLE_CHOC_PRO_RIGHT
	bool "Sofle Choc Pro Right"
	depends on SOC_NRF52840_QIAA
	imply RETAINED_MEM
	imply RETENTION
	imply RETENTION_BOOT_MODE
```
